## main/Kconfig.projbuild
```kconfig
menu "Inverter Monitor"

    config INV_UART_PORT_NUM
        int "UART Port Number (0, 1 or 2)"
        default 1
        range 0 2
        help
            UART peripheral to use for RS232 communication with the inverter.
            UART0 is reserved for the console, so UART1 or UART2 is recommended.

    config INV_UART_TX_GPIO
        int "UART TX GPIO pin"
        default 17
        range 0 48
        help
            GPIO connected to the TX pin of the MAX3232 level-shifter.
            Data flows ESP32-S3 → Inverter.

    config INV_UART_RX_GPIO
        int "UART RX GPIO pin"
        default 18
        range 0 48
        help
            GPIO connected to the RX pin of the MAX3232 level-shifter.
            Data flows Inverter → ESP32-S3.

    config INV_UART_BAUD
        int "UART Baud Rate"
        default 2400
        help
            Baud rate for RS232 communication with the inverter.
            The PI30 protocol standard is 2400 bps. Some units use 9600 bps.

endmenu
```
